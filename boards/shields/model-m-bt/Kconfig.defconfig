## boards/shields/nice60/Kconfig.defconfig
```kconfig
# Copyright (c) 2021 Nick Winans
# SPDX-License-Identifier: MIT

if model-m-nrf

config ZMK_KEYBOARD_NAME
    default "model-m-bt"

if USB_DEVICE_STACK

config USB_NRFX
    default y

endif # USB_DEVICE_STACK

config BT_CTLR
    default BT

endif # model-m-nrf
```
